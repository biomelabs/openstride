## boards/xiao_ble_nrf52840_sense.conf
```kconfig
# XIAO nRF52840 Sense
CONFIG_LSM6DSL=y  # LSM6DS3TR-C uses the lsm6dsl driver (not lsm6dso)
CONFIG_LSM6DSL_TRIGGER_OWN_THREAD=y
CONFIG_LSM6DSL_THREAD_STACK_SIZE=4096
CONFIG_SENSOR=y
CONFIG_I2C=y
CONFIG_GPIO=y
CONFIG_REGULATOR=y
CONFIG_REGULATOR_FIXED=y

# BLE running speed & cadence peripheral
CONFIG_BT=y
CONFIG_BT_PERIPHERAL=y
CONFIG_BT_DEVICE_NAME="OpenStride"

# 0x0441 = 1089, appears as "Running/Walking Sensor, In-Shoe"
CONFIG_BT_DEVICE_APPEARANCE=1089
CONFIG_BT_SMP=y

# Standard BLE Battery Service (0x180F) + ADC for VBAT reading on P0.31 (AIN7)
CONFIG_BT_BAS=y
CONFIG_ADC=y

# 1024 bytes isn't enough for the GATT notify call stack from bt_bas_set_battery_level
CONFIG_SYSTEM_WORKQUEUE_STACK_SIZE=2048
```

## boards/xiao_nrf54l15_nrf54l15_cpuapp.conf
```kconfig
# XIAO nRF54L15 Sense
CONFIG_GPIO=y
CONFIG_I2C=y
CONFIG_SENSOR=y
CONFIG_LSM6DSL=y  # LSM6DS3TR-C uses the lsm6dsl driver, not lsm6dso
CONFIG_LSM6DSL_TRIGGER_NONE=y

# external Qwiic aux sensors on i2c22 (D4/D5)
CONFIG_ADXL345=y
CONFIG_BMP388=y
CONFIG_BMP388_TRIGGER_NONE=y

# BLE running speed & cadence peripheral
CONFIG_BT=y
CONFIG_BT_PERIPHERAL=y
CONFIG_BT_DEVICE_NAME="OpenStride"

# 0x0441 = 1089, appears as "Running/Walking Sensor, In-Shoe"
CONFIG_BT_DEVICE_APPEARANCE=1089
CONFIG_BT_SMP=y

# Raw IMU streaming over NUS (Nordic UART Service)
CONFIG_BT_NUS=y
CONFIG_BT_L2CAP_TX_MTU=247
CONFIG_BT_BUF_ACL_TX_SIZE=251
CONFIG_BT_ATT_TX_COUNT=4

# extra supervision margin while stride math runs on SoftDevice (units: 10 ms)
CONFIG_BT_PERIPHERAL_PREF_TIMEOUT=400

# Standard BLE Battery Service (0x180F) + ADC for VBAT on P1.14 (AIN7)
# vbat_pwr regulator (P1.15) is toggled by battery.c before/after each read
CONFIG_BT_BAS=y
CONFIG_ADC=y

# 1024 bytes isn't enough for the GATT notify call stack from bt_bas_set_battery_level
CONFIG_SYSTEM_WORKQUEUE_STACK_SIZE=2048
```

## tests/unit/testcase.yaml
```yaml
tests:
  openstride.sdm.unit:
    tags:
      - unit
      - sdm
    platform_allow:
      - native_sim
    integration_platforms:
      - native_sim
```

## west.yml
```yaml
manifest:
  version: "1.0"

  remotes:
    - name: nrfconnect
      url-base: https://github.com/nrfconnect
    - name: ant-nrfconnect
      url-base: https://github.com/ant-nrfconnect

  projects:
    - name: nrf
      remote: nrfconnect
      repo-path: sdk-nrf
      revision: v3.2.4
      path: nrf
      import:
        path-prefix: vendor
    - name: sdk-ant
      remote: ant-nrfconnect
      revision: v2.1.0
      path: vendor/sdk-ant
      groups:
        - ant

  # ANT is opt-in. Users without private repo access can run `west update`.
  group-filter:
    - -ant

  self:
    path: .
```
